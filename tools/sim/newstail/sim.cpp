// Перевірка news_cut_tail (firmware/src/feeds.cpp) зі справжнім String ядра Arduino-ESP32 1.0.4 (tools/sim/newstail):
// хвіст GNews «... [N chars]» прибирається, текст закінчується на повному реченні або на цілому слові з «...».
// Зразки — вигадані, тієї ж будови, що й відповіді GNews на безкоштовному тарифі.
#include <Arduino.h>
#include "cut.inc"   // static void news_cut_tail(String &c) — з firmware/src/feeds.cpp

static int bad = 0;
static void t(const char *in, const char *want) {
  String c(in);
  news_cut_tail(c);
  bool ok = c.equals(want);
  if (!ok) bad++;
  printf("%s «%s»\n    → «%s»\n", ok ? "так" : "НІ ", in, c.c_str());
  if (!ok) printf("    очікувалось «%s»\n", want);
}

int main(int argc, char **argv) {
  if (argc > 1) {                 // свій рядок: ./run.sh "текст... [123 chars]"
    String c(argv[1]);
    news_cut_tail(c);
    printf("%s\n", c.c_str());
    return 0;
  }
  // останнє повне речення в другій половині тексту
  t("Уряд ухвалив нове рішення щодо тарифів. Воно набуде чинності з першого грудня, повідомили в міністерстві. "
    "Речник уточнив, що змін для пільговиків не буде. Подробиці обіця... [2072 chars]",
    "Уряд ухвалив нове рішення щодо тарифів. Воно набуде чинності з першого грудня, повідомили в міністерстві. "
    "Речник уточнив, що змін для пільговиків не буде.");
  // речень у другій половині немає — ціле слово й «...», кома перед обрізом не лишається
  t("Синоптики попереджають про сильний вітер у західних областях, місцями з поривами до двадцяти метрів за секунду, "
    "а також про мокрий сніг, ожеледицю, обірва... [1500 chars]",
    "Синоптики попереджають про сильний вітер у західних областях, місцями з поривами до двадцяти метрів за секунду, "
    "а також про мокрий сніг, ожеледицю...");
  // ініціал «Д.» — не кінець речення
  t("Делегації зустрілися вдруге. Після зустрічі заступник міністра Д. Коваль заявив журналістам про перші домовленості "
    "щодо обміну полоненими й гумані... [980 chars]",
    "Делегації зустрілися вдруге. Після зустрічі заступник міністра Д. Коваль заявив журналістам про перші домовленості "
    "щодо обміну полоненими й...");
  // «+» перед числом, знак питання й оклику
  t("Що буде з цінами? Економісти мають різні думки. Одні чекають зростання! Інші кажуть про стабіліза... [+812 chars]",
    "Що буде з цінами? Економісти мають різні думки. Одні чекають зростання!");
  // лапка після кінця речення
  t("Голова громади сказав коротко: 'Ми відбудуємо міст до весни.' Роботи вже почали підрядни... [640 chars]",
    "Голова громади сказав коротко: 'Ми відбудуємо міст до весни.'");
  // текст і так закінчився реченням перед «...»
  t("Матч завершився внічию.... [300 chars]", "Матч завершився внічию.");
  // пробіл у кінці (переведення рядка після text_typography_fix)
  t("Коротко. Довге речення статті, яке вже скінчилося. Ще одне обірва... [99 chars] ",
    "Коротко. Довге речення статті, яке вже скінчилося.");
  // лише хвіст
  t("... [123 chars]", "");
  // без хвоста — без змін
  t("Звичайний текст без хвоста, обірва...", "Звичайний текст без хвоста, обірва...");
  t("Текст [оновлено] і далі", "Текст [оновлено] і далі");
  t("Текст [12 знаків] наприкінці [x chars]", "Текст [12 знаків] наприкінці [x chars]");
  t("", "");
  printf("%s: невдалих %d\n", bad ? "ПОМИЛКА" : "усе гаразд", bad);
  return bad != 0;
}
